## boards/arm/bluepill/Kconfig.board
```kconfig
# Kconfig - STM32F103 Blue pill board configuration
#
# Copyright (c) 2016 Open-RnD Sp. z o.o.
#
# SPDX-License-Identifier: Apache-2.0
#

config BOARD_BLUE_PILL
	bool "STM32F103 Blue Pill"
	depends on SOC_STM32F103XB
```

## boards/arm/bluepill/Kconfig.defconfig
```kconfig
# Kconfig - STM32F103 Blue Pill board configuration
#
# Copyright (c) 2016 Open-RnD Sp. z o.o.
#
# SPDX-License-Identifier: Apache-2.0
#

if BOARD_BLUE_PILL

config BOARD
	default "bluepill"

if UART_CONSOLE

config UART_STM32_PORT_2
	default y

endif # UART_CONSOLE

if PWM

config PWM_STM32_1
	default y

endif # PWM

if SPI

config SPI_1
	default y

config SPI_2
	default y

endif

endif # BOARD_BLUE_PILL
```
